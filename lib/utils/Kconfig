## lib/utils/Kconfig
```kconfig
# SPDX-License-Identifier: BSD-2-Clause

menu "Utils and Drivers Support"

source "$(OPENSBI_SRC_DIR)/lib/utils/fdt/Kconfig"

source "$(OPENSBI_SRC_DIR)/lib/utils/gpio/Kconfig"

source "$(OPENSBI_SRC_DIR)/lib/utils/i2c/Kconfig"

source "$(OPENSBI_SRC_DIR)/lib/utils/ipi/Kconfig"

source "$(OPENSBI_SRC_DIR)/lib/utils/irqchip/Kconfig"

source "$(OPENSBI_SRC_DIR)/lib/utils/libfdt/Kconfig"

source "$(OPENSBI_SRC_DIR)/lib/utils/reset/Kconfig"

source "$(OPENSBI_SRC_DIR)/lib/utils/serial/Kconfig"

source "$(OPENSBI_SRC_DIR)/lib/utils/sys/Kconfig"

source "$(OPENSBI_SRC_DIR)/lib/utils/timer/Kconfig"

source "$(OPENSBI_SRC_DIR)/lib/utils/psci/Kconfig"

config ENABLE_LOGGING
	bool "Enable Logging"
	default n
	help
	  Enables or disables logging throughout the system.
	  Enable this option to allow the system to print log messages.

endmenu
```

## lib/utils/psci/Kconfig
```kconfig
# SPDX-License-Identifier: BSD-2-Clause

menu "ARM's power management framework Support"

config ARM_PSCI_SUPPORT
	bool "Support psci protocol"
	default n

if ARM_PSCI_SUPPORT

config ARM_SCMI_PROTOCOL_SUPPORT
	bool "Using r-core and arm's scmi protocol to dealing with the pwr management"
	default n

config ARM_NON_SCMI_SUPPORT
	bool "dealing with the pwr management in Machine mode-opensbi"
	default n

endif

endmenu
```

## platform/generic/Kconfig
```kconfig
# SPDX-License-Identifier: BSD-2-Clause

config PLATFORM_GENERIC
	bool
	select FDT
	select FDT_DOMAIN
	select FDT_PMU
	default y

if PLATFORM_GENERIC

config PLATFORM_GENERIC_NAME
	string "Platform default name"
	default "Generic"

config PLATFORM_GENERIC_MAJOR_VER
	int "Platform major version"
	range 0 65535
	default 0

config PLATFORM_GENERIC_MINOR_VER
	int "Platform minor version"
	range 0 65535
	default 1

config PLATFORM_ALLWINNER_D1
	bool "Allwinner D1 support"
	depends on FDT_IRQCHIP_PLIC
	default n

config PLATFORM_ANDES_AE350
	bool "Andes AE350 support"
	select SYS_ATCSMU
	default n

config PLATFORM_RENESAS_RZFIVE
	bool "Renesas RZ/Five support"
	select ANDES45_PMA
	select ANDES_SBI
	default n

config PLATFORM_SIFIVE_FU540
	bool "SiFive FU540 support"
	default n

config PLATFORM_SIFIVE_FU740
	bool "SiFive FU740 support"
	depends on FDT_RESET && FDT_I2C
	default n

config PLATFORM_STARFIVE_JH7110
	bool "StarFive JH7110 support"
	default n

config PLATFORM_SPACEMIT_K1PRO
	bool "Spacemit K1pro support"
	default n

if PLATFORM_SPACEMIT_K1PRO
	config PLATFORM_SPACEMIT_K1PRO_FPGA
		bool "Spacemit K1pro board fpga"
		default n

	config PLATFORM_SPACEMIT_K1PRO_QEMU
		bool "Spacemit K1pro board qemu"
		default n

	config PLATFORM_SPACEMIT_K1PRO_SIM
		bool "Spacemit K1pro board sim"
		default n

	config PLATFORM_SPACEMIT_K1PRO_VERIFY
		bool "Spacemit K1pro board verify"
		default n
endif

config PLATFORM_SPACEMIT_K1X
	bool "Spacemit K1x support"
	default n

if PLATFORM_SPACEMIT_K1X
	config PLATFORM_SPACEMIT_K1X_FPGA
		bool "Spacemit K1x board fpag"
		default n

	config PLATFORM_SPACEMIT_K1X_EVB
		bool "Spacemit K1x board evb"
		default n

	config BOOTING_FROM_NO_AI_CORE
		bool "Spacemit k1x booting from non-ai core"
		default n
endif

source "$(OPENSBI_SRC_DIR)/platform/generic/andes/Kconfig"

endif
```

## platform/generic/configs/k1_defconfig
```kconfig
CONFIG_PLATFORM_SPACEMIT_K1X=y
CONFIG_PLATFORM_SPACEMIT_K1X_EVB=y
# CONFIG_SBI_ECALL_TIME is not set
CONFIG_FDT_IPI=y
CONFIG_FDT_IPI_MSWI=y
CONFIG_FDT_IRQCHIP=y
CONFIG_FDT_IRQCHIP_PLIC=y
CONFIG_FDT_RESET=y
CONFIG_FDT_RESET_HTIF=y
CONFIG_FDT_RESET_SIFIVE_TEST=y
CONFIG_FDT_RESET_SUNXI_WDT=y
CONFIG_FDT_RESET_THEAD=y
CONFIG_FDT_SERIAL=y
CONFIG_FDT_SERIAL_UART8250=y
CONFIG_ARM_PSCI_SUPPORT=y
CONFIG_ARM_NON_SCMI_SUPPORT=y
```
